char *message = "Sup world";

void setup() {
  Serial.begin(9600);
  Serial.println("Starting");
  calcCrc(message, 0x07);
}

void loop() {
  
}

void calcCrc(char *codeword, byte poly) { //Calculate CRC given the message and poly
  
  char regByte = 0;
  char bufferByte = 0;
  bool regByteCheck = false;
  
  for (int byteIndex = 0; byteIndex <= strlen(message); byteIndex++) {
    
    bufferByte = codeword[byteIndex]; //Set the buffer byte to the next byte in message
    
    for (int cycleIndex = 0; cycleIndex < 8; cycleIndex++) { //For every bit in the register byte
      regByteCheck = regByte & 0x80; //Check if the first bit is a one
      regByte = regByte << 1; //Shift register to left by one byte
      regByte = regByte | ((bufferByte << cycleIndex) & 0x80) >> 7; //Put the corresponeding bit from the buffer byte in the last place of the register
      if (regByteCheck)  {
        regByte = regByte ^ poly; //If the first bit of the register was a one XOR the poly into the register
      }
    }
  } 
    printByte(regByte);
}
  
void printByte (byte currentByte) { //Prints out every bit of a byte
  Serial.println("");
  for (int i = 0; i < 8; i++) {
    Serial.println(bool(currentByte & (0x80 >> i)));
  }
  Serial.println("");
}